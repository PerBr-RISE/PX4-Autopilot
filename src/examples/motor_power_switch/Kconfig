## src/examples/motor_power_switch/Kconfig
```kconfig
menuconfig EXAMPLES_MOTOR_POWER_SWITCH
    bool "Enable Motor Power Control"
    default y
    help
        This option enables the motor power control application.
```
